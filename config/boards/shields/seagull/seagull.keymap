#include <behaviors.dtsi>
#include <dt-bindings/zmk/keys.h>

#define NUMPAD 0
#define BLUETOOTH 1

/ {
    keymap {
        compatible = "zmk,keymap";

        layer_numpad {
            display-name = "Numpad";

            // +---------------------------+                      
            // |   7  |   8  |   9  |   *  |                      
            // +------+------+------+------+
            // |   4  |   5  |   6  |   /  |                      
            // +------+------+------+------+-------+     
            // |   1  |   2  |   3  |   *  | L-BT  |                     
            // +------+------+------+------+-------+    
            // |   0  |   .  |  +   |   =  |                          
            // +------+------+------+------+  

            bindings = <
&kp N1  &kp N2  &kp N3  &kp N4  &kp N5  &kp N6  &kp N7  &kp N8  &kp N9  &kp N0  &kp A  &kp B  &kp C  &kp D  &mo 1
            >;

            sensor-bindings = <&inc_dec_kp C_VOL_UP C_VOL_DN>;
        };

        layer_bluetooth {
            display-name = "BT";

            // +---------------------------+                      
            // |CLEAR |      |      |BTLDR |                      
            // +------+------+------+------+
            // |      |      |      |      |                      
            // +------+------+------+------+-------+     
            // | PF1  | PF2  |  PF3 |      | L-BT  |                      
            // +------+------+------+------+-------+    
            // |      |      |      |      |                          
            // +------+------+------+------+     

            bindings = <
&kp A  &kp B  &kp C  &kp D  &kp E  &kp N1  &kp N2  &kp N3  &kp N4  &kp N5  &kp N6  &kp N7  &kp N8  &kp N9  &mo 1
            >;

            sensor-bindings = <&inc_dec_kp LC(Z) LC(Y)>;
        };
    };
};
