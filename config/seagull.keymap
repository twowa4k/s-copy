#include <behaviors.dtsi>
#include <dt-bindings/zmk/bt.h>
#include <dt-bindings/zmk/keys.h>

#define NUMPAD 0
#define BLUETOOTH 1

/ {
    keymap {
        compatible = "zmk,keymap";

        layer_numpad {
            display-name = "Numpad";

            // +---------------------------+                      
            // |   7  |   8  |   9  |   *  |                      
            // +------+------+------+------+
            // |   4  |   5  |   6  |   /  |                      
            // +------+------+------+------+-------+     
            // |   1  |   2  |   3  |   *  | L-BT  |                     
            // +------+------+------+------+-------+    
            // |   0  |   .  |  +   |   =  |                          
            // +------+------+------+------+  

            bindings = <
&kp C  &kp J  &kp D  &kp KP_MULTIPLY  &kp KP_N4  &kp KP_N5  &kp KP_N6  &kp KP_DIVIDE
            >;

            sensor-bindings = <&inc_dec_kp C_VOL_UP C_VOL_DN>;
        };

        layer_bluetooth {
            display-name = "BT";

            // +---------------------------+                      
            // |CLEAR |      |      |BTLDR |                      
            // +------+------+------+------+
            // |      |      |      |      |                      
            // +------+------+------+------+-------+     
            // | PF1  | PF2  |  PF3 |      | L-BT  |                      
            // +------+------+------+------+-------+    
            // |      |      |      |      |                          
            // +------+------+------+------+     

            bindings = <
&bt BT_CLR  &none  &none  &bootloader  &none  &none  &none  &none
            >;

            sensor-bindings = <&inc_dec_kp C_VOL_UP C_VOL_DN>;
        };
    };
};
